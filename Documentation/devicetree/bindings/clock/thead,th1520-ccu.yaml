## Documentation/devicetree/bindings/clock/thead,th1520-ccu.yaml
```yaml
# SPDX-License-Identifier: GPL-2.0
%YAML 1.2
---
$id: http://devicetree.org/schemas/clock/thead,th1520-ccu.yaml#
$schema: http://devicetree.org/meta-schemas/core.yaml#

title: T-HEAD Clock Control Unit

maintainers:
  - Jisheng Zhang <jszhang@kernel.org>
  - Wei Fu <wefu@redhat.com>
  - Yangtao Li <frank.li@vivo.com>


properties:
  "#clock-cells":
    const: 1

  "#reset-cells":
    const: 1

  compatible:
    enum:
      - thead,th1520-ccu

  reg:
    maxItems: 1

  clocks:
    const: 2
    items:
      - description: High Frequency Oscillator (usually at 24MHz)
      - description: Low Frequency Oscillator (usually at 32kHz)

  clock-names:
    const: 2
    items:
      - const: hosc
      - const: losc

required:
  - "#clock-cells"
  - compatible
  - reg
  - clocks
  - clock-names

additionalProperties: false

examples:
  - |
    clk: clock-controller@ffef010000 {
      compatible = "thead,th1520-ccu";
      reg = <0xff 0xef010000 0x0 0x1000>;
      clocks = <&osc32k>, <&osc24m>;
      clock-names = "losc", "hosc";
      #clock-cells = <1>;
    };

...
```

## Documentation/devicetree/bindings/interrupt-controller/allwinner,sun20i-d1-intc.yaml
```yaml
# SPDX-License-Identifier: GPL-2.0
%YAML 1.2
---
$id: http://devicetree.org/schemas/interrupt-controller/allwinner,sun20i-d1-intc.yaml#
$schema: http://devicetree.org/meta-schemas/core.yaml#

title: Allwinner D1 Interrupt Controller Device Tree Binding

maintainers:
  - Samuel Holland <samuel@sholland.org>
  - Chen-Yu Tsai <wens@csie.org>
  - Maxime Ripard <mripard@kernel.org>

allOf:
  - $ref: /schemas/interrupt-controller.yaml#

properties:
  compatible:
    const: allwinner,sun20i-d1-intc

  reg:
    maxItems: 1

  '#address-cells':
    const: 0

  clocks:
    maxItems: 1

  resets:
    maxItems: 1

  interrupt-controller: true

  "#interrupt-cells":
    const: 2
    description:
      The first cell is the IRQ number, and the second cell is the trigger type
      as defined in interrupt.txt in this directory.

required:
  - compatible
  - reg
  - clocks
  - resets
  - interrupt-controller
  - "#interrupt-cells"

additionalProperties: false

examples:
  - |
    intc: interrupt-controller@6010000 {
      compatible = "allwinner,sun20i-d1-intc";
      reg = <0x6010000 0x100>;
      #address-cells = <0>;
      clocks = <&ccu 137>;
      resets = <&ccu 65>;
      interrupt-parent = <&plic>;
      interrupt-controller;
      #interrupt-cells = <2>;
    };

...
```

## Documentation/devicetree/bindings/mailbox/allwinner,sun20i-d1-msgbox.yaml
```yaml
# SPDX-License-Identifier: GPL-2.0
%YAML 1.2
---
$id: http://devicetree.org/schemas/mailbox/allwinner,sun20i-d1-msgbox.yaml#
$schema: http://devicetree.org/meta-schemas/core.yaml#

title: Allwinner sunxi Message Box v2

maintainers:
  - Samuel Holland <samuel@sholland.org>

properties:
  compatible:
    oneOf:
      - const: allwinner,sun20i-d1-msgbox

  reg:
    maxItems: 1

  clocks:
    maxItems: 1
    description: bus clock

  resets:
    maxItems: 1
    description: bus reset

  interrupts:
    items:
      - description: receive interrupt
      - description: transmit interrupt

  interrupt-names:
    items:
      - const: "rx"
      - const: "tx"

  '#mbox-cells':
    const: 2
    description: first cell is the user/channel number, second is direction

required:
  - compatible
  - reg
  - clocks
  - resets
  - interrupts
  - interrupt-names
  - '#mbox-cells'

additionalProperties: false

examples:
  - |
    #include <dt-bindings/clock/sun20i-d1-ccu.h>
    #include <dt-bindings/interrupt-controller/irq.h>
    #include <dt-bindings/reset/sun20i-d1-ccu.h>

    msgbox: mailbox@3003000 {
	    compatible = "allwinner,sun20i-d1-msgbox";
	    reg = <0x3003000 0x1000>;
	    clocks = <&ccu CLK_BUS_MSGBOX0>;
	    resets = <&ccu RST_BUS_MSGBOX0>;
	    interrupts = <101 IRQ_TYPE_LEVEL_HIGH>,
			 <102 IRQ_TYPE_LEVEL_HIGH>;
	    interrupt-names = "rx", "tx";
	    #mbox-cells = <2>;
    };

...
```
