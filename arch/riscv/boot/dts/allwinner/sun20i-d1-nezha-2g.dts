// SPDX-License-Identifier: (GPL-2.0+ or MIT)
// Copyright (C) 2021 Wei Fu <wefu@redhat.com>

/dts-v1/;

#include "sun20i-d1-nezha.dts"

/ {
	// FIXME: this is temporary.
	memory@40000000 {
		device_type = "memory";
		reg = <0x40000000 0x80000000>; /* 2 GB */
	};
};
